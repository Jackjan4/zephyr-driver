## dac5571/zephyr/Kconfig
```kconfig
menuconfig DAC5571
	bool "Enable support for DAC5571 8-Bit I2C DAC"
	depends on I2C
	help
		Enable driver for DAC5571 DAC.

if DAC5571

config DAC_DAC5571_INIT_PRIORITY
	int "Init priority"
	default 80
	help
	  TI DAC5571 DAC device driver initialization priority.

endif
```

## dac5571/zephyr/dts/bindings/ti,dac5571.yaml
```yaml
description: TI DAC5571 8-bit single-channel DAC

compatible: "ti,dac5571"

include: [dac-controller.yaml, i2c-device.yaml]

properties:
    "#io-channel-cells":
      const: 1

    power_down_mode:
      type: array
      required: true
      description: |
        Power-down mode select.
        0 - normal mode
        1 - Vout is loaded with 1 kOhm resistor to ground
        2 - Vout is loaded 100 kOhm resistor to ground
        3 - Vout is high impedence
        Note: with values bigger than 0 most of channel circuits are powered off
        Note: array entries correspond to the successive channels

io-channel-cells:
    - output
```

## shockburst/zephyr/Kconfig
```kconfig
#
# Copyright (c) 2018 Nordic Semiconductor ASA
#
# SPDX-License-Identifier: LicenseRef-Nordic-5-Clause
#

menuconfig SHOCKBURST
	bool "Enable support for ShockBurst (not Enhanced)"
	default n
	help
	  Enable Shockburst functionality.

if SHOCKBURST

config SHOCKBURST_MAX_PAYLOAD_LENGTH
	int "Maximum payload size"
	default 32
	range 1 252
	help
	  The maximum size of the payload.

config SHOCKBURST_RADIO_IRQ_PRIORITY
	int "Radio interrupt priority"
	range 0 5 if ZERO_LATENCY_IRQS
	range 0 6
	default 1

endif # NRF_SHOCKBURST
```

## sl025b/zephyr/Kconfig
```kconfig
menuconfig SL025B
	bool "Enable support for Stronglink SL025B RFID module"
	depends on SERIAL
	help
		Enable driver for SL025B RFID.

if SL025B

endif
```

## sl025b/zephyr/dts/bindings/stronglink,sl025b-uart.yaml
```yaml
description: Stronglink SL025B RFID Module on Serial

compatible: "stronglink,sl025b"

include: "uart-device.yaml"
```

## ssd1306a/zephyr/Kconfig
```kconfig
menuconfig SSD1306A
	bool "Enable advanced support for SSD1306 OLED Display"
	depends on I2C || SPI
	help
		Enable driver for SSD1306 display driver.

if SSD1306A

endif
```

## ssd1306a/zephyr/dts/bindings/solomon,ssd1306a-common.yaml
```yaml
include: display-controller.yaml

properties:
  display-offset:
    type: int
    required: true
    description: mapping of the display start line to one of COM0 .. COM63

  multiplex-ratio:
    type: int
    required: true
    description: TODO

  precharge-period:
    type: int
    required: true
    description: The period length of the precharge time

  clock-div-osc-frequency:
    type: int
    required: true
    description: TODO

  display-start-line:
    type: int
    required: true
    description: TODO

  com-pins-config:
    type: int
    required: true
    description: TODO

  memory-addressing-mode:
    type: int
    required: true
    description: TODO

  default-contrast:
    type: int
    required: true
    description: The contrast value to which the display should default to

  charge-pump-enable:
    type: boolean
    description: Whether to enable the integrated charge pump of the OLED driver

  segment-remap:
    type: boolean
    description: Last column address is mapped to first segment

  com-invert-direction:
    type: boolean
    description: Scan direction is from last COM output to first COM output

  reset-gpios:
    type: phandle-array
    description: RESET pin.

      The RESET pin of SSD1306 is active low.
      If connected directly the MCU pin should be configured
      as active low.
```

## ssd1306a/zephyr/dts/bindings/solomon,ssd1306a-i2c.yaml
```yaml
description: Advanced SSD1306 128x128 dot-matrix display controller on I2C bus

compatible: "solomon,ssd1306a"

include: ["solomon,ssd1306a-common.yaml", "i2c-device.yaml"]
```

## ssd1327/zephyr/Kconfig
```kconfig
menuconfig SSD1327
	bool "Enable support for SSD1327 OLED Display"
	depends on I2C || SPI
	help
		Enable driver for SSD1327 display driver.

if SSD1327

endif
```

## ssd1327/zephyr/dts/bindings/solomon,ssd1327-common.yaml
```yaml
include: display-controller.yaml

properties:
    segment-offset:
      type: int
      required: false
      description: 8-bit column start address for Page Addressing Mode

    page-offset:
      type: int
      required: false
      description: Start address for Page Addressing Mode

    display-offset:
      type: int
      required: false
      description: mapping of the display start line to one of COM0 .. COM63

    multiplex-ratio:
      type: int
      required: false
      description: Multiplex Ratio

    remap:
      type: int
      required: true
      description: Last column address is mapped to first segment

    phase-length:
      type: int
      required: true
      description: Last column address is mapped to first segment

    com-invdir:
      type: boolean
      required: false
      description: Scan direction is from last COM output to first COM output

    com-sequential:
      type: boolean
      required: false
      description: Sequential COM pin configuration

    prechargep:
      type: int
      required: false
      description: Duration of the pre-charge period

    front-clock-frequency:
      type: int
      required: false
      description: Duration of the pre-charge period

    precharge-voltage:
      type: int
      required: true
      description: Duration of the pre-charge period

    function-b:
      type: int
      required: true
      description: Duration of the pre-charge period

    vcom-voltage:
      type: int
      required: true
      description: VCOM deselect voltage level

    reset-gpios:
      type: phandle-array
      required: false
      description: RESET pin.

        The RESET pin of SSD1327 is active low.
        If connected directly the MCU pin should be configured
        as active low.
```

## ssd1327/zephyr/dts/bindings/solomon,ssd1327-spi.yaml
```yaml
# Copyright (c) 2020, Marco Peter
# SPDX-License-Identifier: Apache-2.0

description: SSD1327 128x128 dot-matrix display controller on SPI bus

compatible: "solomon,ssd1327"

include: ["solomon,ssd1327-common.yaml", "spi-device.yaml"]

properties:
    data_cmd-gpios:
      type: phandle-array
      required: true
      description: D/C# pin.
```
